#include <Arduino.h>
#include <U8g2lib.h>
#include <Wire.h>
#include <ESP8266WiFi.h>
#include <espnow.h>
#include <ArduinoJson.h>
#include <Servo.h>
Servo Gate;
#define sens1 D6 // GPIO12
#define sens2 D7 // GPIO13
U8G2_SSD1306_128X64_NONAME_F_HW_I2C u8g2(U8G2_R0, /* reset=*/U8X8_PIN_NONE, /* clock=*/D1, /* data=*/D2);
U8G2_SSD1306_128X64_NONAME_F_HW_I2C u8g2_2(U8G2_R0, /* reset=*/U8X8_PIN_NONE, /* clock=*/D1, /* data=*/D2);
int speed = 80;
int space = 20;
int normal_speed = 80;
int max_speed = 255;
int open_angle = 10;
int close_angle = 90;
int max_cars = 10;
String Deticted = "background"; // background , noise
String connected = "no";        // yes , no
bool inc_S1 = false;
bool inc_S2 = false;
int counter = 0;

struct msg
{
  int car_speed;
  int safe_distance;
} msg;
void OnDataSent(uint8_t *mac, uint8_t status)
{
  Serial.print("Send Status: ");
  Serial.println(status == 0 ? "Success" : "Fail");
}
uint8_t car1[] = {0xFC, 0xF5, 0xC4, 0x9B, 0xE5, 0x44};
uint8_t car2[] = {0xF4, 0xCF, 0xA2, 0x74, 0x79, 0xB8};
// ! icon  closed road
static const unsigned char image_download_1_bits[] U8X8_PROGMEM = {0x00, 0x00, 0x80, 0x01, 0x40, 0x02, 0x40, 0x02, 0x20, 0x04, 0x90, 0x09, 0x90, 0x09, 0x88, 0x11, 0x88, 0x11, 0x84, 0x21, 0x02, 0x40, 0x82, 0x41, 0x81, 0x81, 0x01, 0x80, 0xfe, 0x7f, 0x00, 0x00};
// car icon
static const unsigned char image_download_2_bits[] U8X8_PROGMEM = {0x00, 0x00, 0x00, 0x00, 0x00, 0x00, 0x00, 0x00, 0x00, 0x00, 0x00, 0x00, 0x00,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 0x40, 0x00};
static const unsigned char image_fastest_bits[] U8X8_PROGMEM = {0x00, 0x20, 0x08, 0x00, 0x00, 0x20, 0x08, 0x02, 0xff, 0x23, 0x08, 0x02, 0x01,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 0x18, 0x00};
static const unsigned char image_microphone_bits[] U8X8_PROGMEM = {0xc0, 0x01, 0xe0, 0x03, 0xa0, 0x02, 0xe0, 0x03, 0xa0, 0x02, 0xe0, 0x03, 0xa0, 0x02, 0xe0, 0x03, 0xe8, 0x0b, 0xc8, 0x09, 0x10, 0x04, 0xe0, 0x03, 0x80, 0x00, 0x80, 0x00, 0xe0, 0x03, 0x00, 0x00};
static const unsigned char image_road_with_broken_line__1__bits[] U8X8_PROGMEM = {0x00, 0x3a, 0x17, 0x00, 0x00, 0x3b, 0x17, 0x00, 0x00, 0xf9, 0x27, 0x00, 0x00,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 0xff, 0x38};
const char *Layer_3_text = "Main Road";

static const unsigned char image_public_transport_bits[] U8X8_PROGMEM = {0x00, 0x00, 0xff, 0xff, 0xff, 0xff, 0x01, 0x00, 0x00, 0xe0, 0xff, 0xff, 0xff,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 0x07, 0x00};
static const unsigned char image_road_bits[] U8X8_PROGMEM = {0x00, 0x00, 0x1c, 0x00, 0x81, 0x41, 0x00, 0x00, 0x00, 0x00, 0x3e, 0x00, 0x87,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 0x00, 0x00};

static const unsigned char image_ambulance_bits[] U8X8_PROGMEM = {0x00, 0x40, 0x00, 0x00, 0x00, 0x40, 0x00, 0x00, 0x00, 0x42, 0x08, 0x00, 0x00,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 0x80, 0x03};
static const unsigned char image_fire_brigade_bits[] U8X8_PROGMEM = {0x00, 0x00, 0x00, 0x00, 0x00, 0x00, 0x20, 0x00, 0x00, 0x00, 0x00, 0x00, 0x00,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 0xff, 0x3f};
static const unsigned char image_road_with_broken_line__2__bits[] U8X8_PROGMEM = {0x00, 0x00, 0x00, 0x00, 0x00, 0x00, 0x00, 0x00, 0x00, 0x00, 0x00, 0x00, 0x00,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 0x00, 0x00};
void draw(bool, bool);
void draw2(bool);
void send_tocar();
void reciv();
int detectObject(int pin, bool increment,
                 bool &flag, int &counter);

void setup()
{
  pinMode(sens1, INPUT);
  pinMode(sens2, INPUT);
  Serial.begin(9600);
  Wire.begin(D2, D1);
  u8g2.setI2CAddress(0x3C * 2);
  u8g2.begin();
  u8g2_2.setI2CAddress(0x3D * 2);
  u8g2_2.begin();
  WiFi.mode(WIFI_STA);
  WiFi.disconnect();

  if (esp_now_init() != 0)
  {
    Serial.println("ESP-NOW Init Failed");
    return;
  }
  esp_now_set_self_role(ESP_NOW_ROLE_CONTROLLER); // MASTER
  esp_now_register_send_cb(OnDataSent);
  esp_now_add_peer(car1, ESP_NOW_ROLE_SLAVE, 1, NULL, 0);
  esp_now_add_peer(car2, ESP_NOW_ROLE_SLAVE, 1, NULL, 0);
  Gate.attach(D5, 500, 2500);
  Gate.write(open_angle);
  delay(1000);
}
void loop()
{

  counter = detectObject(sens1, true, inc_S1, counter);
  counter = detectObject(sens2, false, inc_S2, counter);
  reciv();
  bool isUsbConnected = (connected == "yes");
  static unsigned long lastTime = 0;
  if (millis() - lastTime > 100)
  {
    lastTime = millis();
    send_tocar();
  }
  if (counter >= max_cars && Deticted != "background")
  {
    draw(isUsbConnected, true);
    draw2(true);
    speed = max_speed;
    Gate.write(close_angle);
  }
  else
  {
    draw(isUsbConnected, false);
    draw2(false);
    speed = normal_speed;
    Gate.write(open_angle);
  }
}

void draw(bool connect, bool road_maxmum)
{
  u8g2.clearBuffer();
  u8g2.setFontMode(1);
  u8g2.setBitmapMode(1);
  // Layer 1
  u8g2.drawFrame(0, 0, 128, 62);

  // Layer 16
  u8g2.drawFrame(109, 3, 16, 21);

  // Layer 3
  u8g2.drawBox(3, 3, 61, 21);

  // Layer 3
  u8g2.setDrawColor(2);
  u8g2.setFont(u8g2_font_6x13_tr);
  u8g2.drawStr(7, 19, Layer_3_text);

  // Layer 4
  u8g2.setDrawColor(1);
  u8g2.drawFrame(3, 24, 122, 36);

  // Layer 5
  u8g2.drawLine(64, 25, 64, 58);

  // microphone
  if (connect)
  {
    u8g2.drawXBMP(110, 6, 15, 16, image_microphone_bits);
  }

  // Layer 11

  u8g2.drawStr(98, 56, "10km");

  // Layer 12
  u8g2.drawStr(45, 56, "6km");

  //  image !road >>> close
  if (road_maxmum)
  {
    u8g2.drawXBMP(19, 28, 16, 16, image_download_1_bits);
    // Layer 9
    u8g2.setFont(u8g2_font_6x10_tr);
    u8g2.drawStr(9, 55, "Close");
  }
  else
  {
    // road_with_broken_line__1_
    u8g2.drawXBMP(20, 26, 30, 22, image_road_with_broken_line__1__bits);
    // Layer 9
    u8g2.setFont(u8g2_font_6x10_tr);
    u8g2.drawStr(9, 55, "Open");
  }

  // Layer 13
  u8g2.drawFrame(64, 3, 46, 21);

  // Layer 15
  u8g2.setFont(u8g2_font_6x13_tr);
  u8g2.drawStr(92, 19, String(counter).c_str());

  // download
  u8g2.drawXBMP(68, 3, 19, 16, image_download_2_bits);

  // Layer 17
  u8g2.drawLine(107, 20, 67, 20);

  // fastest
  u8g2.drawXBMP(69, 27, 32, 32, image_fastest_bits);

  u8g2.sendBuffer();
}

void draw2(bool isMaxCars)
{
  if (!isMaxCars)
  {
    u8g2_2.clearBuffer();
    u8g2_2.setFontMode(1);
    u8g2_2.setBitmapMode(1);
    // public_transport
    u8g2_2.drawXBMP(62, -2, 64, 64, image_public_transport_bits);

    // road
    u8g2_2.drawXBMP(0, 1, 64, 64, image_road_bits);

    u8g2_2.sendBuffer();
  }
  //------------------------case 2-----------------------
  else
  {
    u8g2_2.clearBuffer();
    u8g2_2.setFontMode(1);
    u8g2_2.setBitmapMode(1);
    // road_with_broken_line__1_
    u8g2_2.drawXBMP(0, 0, 64, 64, image_road_with_broken_line__2__bits);

    // ambulance
    u8g2_2.setDrawColor(2);
    u8g2_2.drawXBMP(18, 24, 32, 31, image_ambulance_bits);

    // fire_brigade
    u8g2_2.setDrawColor(1);
    u8g2_2.drawXBMP(61, 11, 64, 45, image_fire_brigade_bits);

    u8g2_2.sendBuffer();
  }
}
void send_tocar()
{
  msg.car_speed = speed;
  msg.safe_distance = space;
  esp_now_send(car1, (uint8_t *)&msg, sizeof(msg));
  esp_now_send(car2, (uint8_t *)&msg, sizeof(msg));
}

void reciv()
{
  if (Serial.available())
  {
    String input = Serial.readStringUntil('\n');

    JsonDocument doc;
    DeserializationError error = deserializeJson(doc, input);

    if (error)
    {
      Serial.print("deserializeJson() failed: ");
      Serial.println(error.c_str());
      return;
    }

    const char *detict = doc["detict"];
    const char *conect = doc["connect"];
    Deticted = String(detict);
    connected = String(conect);
  }
}

int detectObject(int pin, bool increment,
                 bool &flag, int &counter)
{

  int v = digitalRead(pin);

  if (v == LOW && !flag)
  {

    if (increment)
      counter++;
    else
      counter--;

    flag = true;
  }

  if (v == HIGH && flag)
  {
    flag = false;
  }

  return counter;
}
